## arch/arm/mach-snapdragon/Kconfig
```kconfig
if ARCH_SNAPDRAGON

config SYS_SOC
	default "snapdragon"

choice
	prompt "Snapdragon board select"

config TARGET_DRAGONBOARD410C
	bool "96Boards Dragonboard 410C"
endchoice

source "board/qualcomm/dragonboard410c/Kconfig"

endif
```

## board/qualcomm/dragonboard/Kconfig
```kconfig
if TARGET_DRAGONBOARD

config SYS_BOARD
	default "dragonboard"

config SYS_VENDOR
	default "qualcomm"

config SYS_SOC
	default "apq8016"

config SYS_CONFIG_NAME
	default "dragonboard"

endif
```

## configs/dragonboard_defconfig
```kconfig
CONFIG_ARM=y
CONFIG_ARM64=y
CONFIG_ARCH_SNAPDRAGON=y
CONFIG_TARGET_DRAGONBOARD=y

CONFIG_HUSH_PARSER=y
CONFIG_SYS_PROMPT="dragonboard => "
CONFIG_CMD_USB=y
# CONFIG_CMD_IMI is not set
# CONFIG_CMD_IMLS is not set
CONFIG_DEFAULT_DEVICE_TREE="dragonboard"

CONFIG_CLK=y
CONFIG_MSM_GPIO=y
CONFIG_PM8916_GPIO=y
CONFIG_LED=y
CONFIG_LED_GPIO=y
CONFIG_RESET=y
CONFIG_DM_MMC=y
CONFIG_MSM_SDHCI=y
CONFIG_DM_PMIC=y
CONFIG_PMIC_PM8916=y
CONFIG_SPMI_MSM=y
CONFIG_MSM_SERIAL=y
CONFIG_USB=y
CONFIG_DM_USB=y
CONFIG_USB_EHCI_HCD=y
CONFIG_USB_EHCI_MSM=y
CONFIG_USB_STORAGE=y
```

## drivers/spmi/Kconfig
```kconfig
menu "SPMI support"

config DM_SPMI
	bool "Enable SPMI bus support"
	depends on DM
	---help---
	Select this to enable to support SPMI bus.
	SPMI (System Power Management Interface) bus is used
	to connect PMIC devices on various SoCs.

config SPMI_MSM
	boolean "Support Qualcomm SPMI bus"
	depends on DM_SPMI
	---help---
	Support SPMI implementation found on Qualcomm Snapdragon SoCs.

config SPMI_SANDBOX
	boolean "Support for Sandbox SPMI bus"
	depends on DM_SPMI
	---help---
	Demo SPMI bus implementation. Implements single slave/peripheral.

endmenu
```

## drivers/usb/ulpi/Kconfig
```kconfig
comment "ULPI drivers"

config USB_ULPI
	bool

config USB_ULPI_VIEWPORT
	bool

config USB_ULPI_VIEWPORT_OMAP
	bool
```
